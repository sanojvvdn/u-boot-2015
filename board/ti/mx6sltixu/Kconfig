## board/ti/mx6sltixu/Kconfig
```kconfig
if TARGET_MX6SLTIXU

config SYS_BOARD
	default "mx6sltixu"

config SYS_VENDOR
	default "ti"

config SYS_CONFIG_NAME
	default "mx6sltixu"

endif
```

## configs/mx6sltixu_defconfig
```kconfig
CONFIG_ARM=y
CONFIG_ARCH_MX6=y
CONFIG_TARGET_MX6SLTIXU=y
CONFIG_SYS_EXTRA_OPTIONS="IMX_CONFIG=board/ti/mx6sltixu/imximage.cfg,MX6SL"
# CONFIG_CMD_IMLS is not set
# CONFIG_CMD_FLASH is not set
# CONFIG_CMD_SETEXPR is not set
CONFIG_DM=y
CONFIG_SPI_FLASH=y
CONFIG_DM_THERMAL=y
```
